## conf/distro/debian-sid.conf
```bitbake
# This software is a part of ISAR.
# Copyright (C) 2017 Mixed Mode GmbH

DISTRO_SUITE = "sid"
DISTRO_ARCH = "armhf"
DISTRO_COMPONENTS = "main contrib non-free"
DISTRO_APT_SOURCE = "http://httpredir.debian.org/debian"
DISTRO_CONFIG_SCRIPT = "debian-configscript.sh"

BASE_PACKAGES = " \
                python3 \
                python3-serial \
                "

ADMIN_PACKAGES=" \
                sudo \
                vim \
                openssh-server \
                net-tools \
               "


IMAGE_PREINSTALL = " \
                   ${BASE_PACKAGES} \
                   ${ADMIN_PACKAGES} \
                   "

IMAGE_FEATURES = " systemd "
IMAGE_INSTALL_append = " linux-image u-boot "
```

## conf/layer.conf
```bitbake
# We have a conf and classes directory, add to BBPATH
BBPATH .= ":${LAYERDIR}"

# We have recipes-* directories, add to BBFILES
BBFILES +=  "${LAYERDIR}/recipes-*/*/*.bb"
BBFILES +=  " ${LAYERDIR}/recipes-*/*/*.bbappend "

BBFILE_COLLECTIONS += "nanopi"
BBFILE_PATTERN_nanopi = "^${LAYERDIR}/"
BBFILE_PRIORITY_nanopi = "6"

# This should only be incremented on significant changes that will
# cause compatibility issues with other layers
LAYERVERSION_nanopi = "1"

LAYERDIR_nanopi = "${LAYERDIR}"
```

## conf/machine/nanopi-neo-air.conf
```bitbake
# This software is a part of ISAR.
# Copyright (C) 2017 Mixed-Mode

# Configuration for machine nanopi-neo-air.
PREFERRED_PROVIDER_virtual/kernel = "linux-image-sunxi-cross"
PREFERRED_VERSION_virtual/kernel = "4.13"
PREFERRED_PROVIDER_virtual/bootloader = "u-boot-sunxi-cross"
PREFERRED_VERSION_virtual/bootloader = "2017.13"

KIMAGE_TYPE="uImage"
KERNEL_CMDLINE="console=${MACHINE_SERIAL},115200 console=tty1 rw rootwait panic=10"

UIMAGE_LOADADDR="0x40008000"
DTBS="sun8i-h3-nanopi-neo-air.dtb"

BOOTSCRIPT = "boot.scr"
IMAGE_BOOT_FILES = "${BOOTSCRIPT} ${KIMAGE_TYPE} dts/${DTBS};${DTBS}"
BOOT_IMG = "u-boot-sunxi-with-spl.bin"

MACHINE_SERIAL = "ttyS0"

IMAGE_TYPES = "sdcard sdcard-redundant"

# Set further target architecture specifics
TARGET_ARCH="arm"
TARGET_PREFIX="arm-linux-gnueabihf"

# Using for interface compatibility
DEB_ARCH="${DISTRO_ARCH}"

# Device from which to boot from
BOOT_DEVICE = "mmc"
BOOT_DEVICE_LINUX = "mmcblk0p"
ROOT_DEVICE_LINUX = "${BOOT_DEVICE_LINUX}"
BOOTDEVICE_FSTYPE = "vfat"

# Boot device identifiers required by u-boot
BOOT_DEVICE_NUM="0"

# Partition number of rootfs partitions
ROOTP_PRIM_NUM = "2"
ROOTP_SEC_NUM = "3"

# Partition number of boot partitions, since kernel and device tree reside on the
# rootfs itself, the same values as for root partitions where set.
BOOTP_PRIM_NUM = "${ROOTP_PRIM_NUM}"
BOOTP_SEC_NUM = "${ROOTP_SEC_NUM}"

# Bootscript and recovery files are stored here.
RECOVERY_BOOTPART_NUM = "1"
```
